// ==================  ФУНКЦИИ ДАТЫ  ====================
// Дата хранится в микросхеме RTC (DS3231), отдельно в EEPROM не дублируется.
// Формат отображения на индикаторах: ДД.ММ
//   1-я и 2-я лампы - число месяца (день)
//   3-я и 4-я лампы - номер месяца

// отправить дату на индикаторы
void sendDate(byte day, byte month) {
  indiDigits[0] = (byte)day / 10;
  indiDigits[1] = (byte)day % 10;

  indiDigits[2] = (byte)month / 10;
  indiDigits[3] = (byte)month % 10;
}

// отправить год на индикаторы (все 4 цифры года, например 2026).
// Используется ТОЛЬКО в настройке даты (curMode == 1) - в автопоказе
// даты (curMode == 3, см. dateShowTick()) год никогда не показывается.
void sendYear(int16_t year) {
  indiDigits[0] = (byte)(year / 1000) % 10;
  indiDigits[1] = (byte)(year / 100) % 10;
  indiDigits[2] = (byte)(year / 10) % 10;
  indiDigits[3] = (byte)(year % 10);   // ВАЖНО: сначала % 10, потом (byte) - год (например,
                                        // 2026) сам по себе не помещается в byte (макс. 255),
                                        // поэтому (byte)year сначала обрезает его (2026 % 256 = 234),
                                        // и только потом %10 даёт неверную цифру (234 % 10 = 4
                                        // вместо правильной 6) - из-за этого "2026" отображался
                                        // как "2024". Права computation: year % 10 = 6 - результат
                                        // уже помещается в byte, обрезать нечего.
}

// количество дней в месяце (1-12) с учётом високосного года.
// Для month == 0 (сентинел "показ даты выключен") возвращает 31 -
// в этом случае само число дня всё равно не сохраняется в RTC.
byte daysInMonth(byte month, int16_t year) {
  const byte DAYS_IN_MONTH[] = {31, 28, 31, 30, 31, 30, 31, 31, 30, 31, 30, 31};
  if (month < 1 || month > 12) return 31;
  if (month == 2) {
    boolean leap = (year % 4 == 0 && (year % 100 != 0 || year % 400 == 0));
    return leap ? 29 : 28;
  }
  return DAYS_IN_MONTH[month - 1];
}

// ограничить редактируемое число месяца допустимым диапазоном для
// текущих changeMonth/changeYear. Вызывается после изменения ЛЮБОГО
// из параметров (часы, минуты, число, месяц, год) в настройке даты,
// поэтому если, например, выставить число 30, а затем переключить
// месяц на февраль, число само уменьшится до 28 (или 29 в
// високосный год) - ввести несуществующую дату через меню нельзя.
void clampChangeDay() {
  byte maxDay = daysInMonth(changeMonth, changeYear);
  if (changeDay > maxDay) changeDay = maxDay;
  if (changeDay < 1) changeDay = 1;
}

// Периодический автоматический показ даты в режиме часов.
// Включение и параметры задаются в главном файле прошивки:
//   DATE_SHOW_ENABLE   - 1 вкл / 0 выкл всей функции (требует перепрошивки)
//   DATE_SHOW_INTERVAL - через сколько секунд показывать дату
//   DATE_SHOW_DURATION - сколько секунд держать дату на индикаторах
// Кроме того, показ даты можно выключить/включить кнопками без
// перепрошивки: в настройке времени/даты (curMode == 1) установка
// месяца в 00 выключает показ (флаг dateShowAllowed, хранится в
// EEPROM по адресу 10), любое значение месяца 1-12 - включает.
// Вызывается каждую итерацию loop(). Нажатие любой кнопки во время
// показа даты обрабатывается в buttonsTick() (curMode == 3) и сразу
// прерывает показ, возвращая часы к отображению времени.
void dateShowTick() {
#if (DATE_SHOW_ENABLE == 1)
  if (simplifiedMode) return;     // дата полностью отключена в упрощённом режиме управления
  if (!dateShowAllowed) return;   // показ даты выключен пользователем (месяц установлен в 00)
  if (!dateShowing) {
    // интервал до показа даты отсчитывается по реальному времени (millis()),
    // но при входе в любое меню (настройка времени/даты, яркость) и при
    // каждом выходе из него таймер сбрасывается (см. buttonsSettings.ino) -
    // поэтому время, проведённое в меню, фактически не засчитывается
    if (curMode == 0 && dateShowTimer.isReady()) {
      DateTime now = rtc.now();
      sendDate(now.day(), now.month());
      for (byte i = 0; i < 4; i++) {
        anodeStates[i] = 1;
        indiDimm[i] = indiMaxBright;
      }
      dateShowDurationTimer.reset();
      dateShowing = true;
      curMode = 3;
    }
  } else {
    if (dateShowDurationTimer.isReady()) {
      dateShowing = false;
      curMode = 0;
      sendTime(hrs, mins);   // вернуться к отображению времени
      dateShowTimer.reset(); // следующий показ - через полный интервал от этого момента
    }
  }
#endif
}
